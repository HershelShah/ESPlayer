## sdkconfig.defaults
```kconfig
# CPU
CONFIG_ESP32_DEFAULT_CPU_FREQ_240=y

# Bluetooth
CONFIG_BT_ENABLED=y
CONFIG_BT_CLASSIC_ENABLED=y
CONFIG_BT_A2DP_ENABLE=y
CONFIG_BTDM_CTRL_MODE_BR_EDR_ONLY=y
CONFIG_BT_ALLOCATION_FROM_SPIRAM_FIRST=n
CONFIG_BT_BLE_ENABLED=n

# FAT / SD
CONFIG_FATFS_LFN_HEAP=y
CONFIG_FATFS_MAX_LFN=255
CONFIG_FATFS_API_ENCODING_UTF_8=y

# SPI
CONFIG_SPI_MASTER_ISR_IN_IRAM=y

# Memory optimization
CONFIG_COMPILER_OPTIMIZATION_SIZE=y

# No PSRAM
CONFIG_SPIRAM=n

# Stack sizes (reduced to save heap)
CONFIG_ESP_MAIN_TASK_STACK_SIZE=4096
CONFIG_BT_BTU_TASK_STACK_SIZE=4096

# Flash — CYD has 4MB
CONFIG_ESPTOOLPY_FLASHSIZE_4MB=y

# Partition table
CONFIG_PARTITION_TABLE_CUSTOM=y
CONFIG_PARTITION_TABLE_CUSTOM_FILENAME="partitions.csv"

# Log level — INFO for development
CONFIG_LOG_DEFAULT_LEVEL_INFO=y
CONFIG_LOG_DEFAULT_LEVEL=3
```
